## firmware/sdkconfig.defaults
```kconfig
# Увеличен таймаут watchdog для E-Ink (display refresh ~2-5 сек)
CONFIG_ESP_TASK_WDT_TIMEOUT_S=30

# NimBLE host: IDF default 4096. Безопасно при LOG_LEVEL ≤ 1 (verbose log расходует стек).
CONFIG_BT_NIMBLE_HOST_TASK_STACK_SIZE=8192

# NimBLE heap reduction (V3 OLED без PSRAM — всё в internal SRAM):
# 1 connection (телефон ↔ устройство), 1 bond, 2 CCCD (1 NOTIFY char), MSYS 8 блоков (MTU 517)
CONFIG_BT_NIMBLE_MAX_CONNECTIONS=1
CONFIG_BT_NIMBLE_MAX_BONDS=1
CONFIG_BT_NIMBLE_MAX_CCCDS=2
CONFIG_BT_NIMBLE_MSYS1_BLOCK_COUNT=8

# Меньше принудительных internal malloc — в SPIRAM (IDF); нужен запас под UART/GPS после Wi‑Fi
CONFIG_SPIRAM_MALLOC_ALWAYSINTERNAL=512

# WiFi event queue: 32 достаточно для STA_START; 64 съедало лишний internal (Paper/OLED)
CONFIG_ESP_SYSTEM_EVENT_QUEUE_SIZE=32

# packetTask 16K: при фрагментированном internal DRAM — стек в PSRAM (async_tasks xTaskCreateWithCaps)
CONFIG_SPIRAM_ALLOW_STACK_EXTERNAL_MEMORY=y

# WiFi/LwIP: буферы по возможности в SPIRAM — больше contiguous internal под esp_wifi_init после NimBLE
CONFIG_SPIRAM_TRY_ALLOCATE_WIFI_LWIP=y

# NimBLE: куча хоста предпочтительно во внешней RAM (fallback во internal в IDF)
CONFIG_BT_NIMBLE_MEM_ALLOC_MODE_EXTERNAL=y

# RF coexistence + ядра (ESP32-S3): один 2.4 GHz тракт — SW coex; контроллер BLE + NimBLE на одном CPU,
# задача Wi‑Fi на другом (см. IDF RF Coexistence → compile-time options, чип S3 — BT_CTRL, не BTDM).
# https://docs.espressif.com/projects/esp-idf/en/stable/esp32s3/api-guides/coexist.html
CONFIG_ESP_COEX_SW_COEXIST_ENABLE=y
CONFIG_BT_CTRL_PINNED_TO_CORE_1=y
CONFIG_BT_NIMBLE_PINNED_TO_CORE_1=y
CONFIG_ESP_WIFI_TASK_CORE_ID=0

# WiFi: static RX минимум 2 (IDF). Совпадает с wifi::applyLowFootprintWifiConfig.
CONFIG_ESP_WIFI_STATIC_RX_BUFFER_NUM=2
CONFIG_ESP_WIFI_DYNAMIC_RX_BUFFER_NUM=2
CONFIG_ESP_WIFI_MGMT_SBUF_NUM=6
CONFIG_ESP_WIFI_AMPDU_RX_ENABLED=n
CONFIG_ESP_WIFI_AMPDU_TX_ENABLED=n
CONFIG_ESP_WIFI_AMSDU_TX_ENABLED=n

# Меньше internal под стек ppTask — иначе после NimBLE xTaskCreate(wifi) падает с "failed to create task"
CONFIG_ESP_WIFI_TASK_STACK_SIZE=2560
```
